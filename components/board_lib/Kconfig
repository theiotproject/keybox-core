## components/board_lib/Kconfig
```kconfig
config ENV_GPIO_RANGE_MIN
    int
    default 0

config ENV_GPIO_RANGE_MAX
    int
    default 39

config ENV_GPIO_IN_RANGE_MAX
    int
    default ENV_GPIO_RANGE_MAX

config ENV_GPIO_OUT_RANGE_MAX
    int
    default 33

menu "Board Library"

    config BOARD_BUZZ_GPIO
        int "Buzzer GPIO number"
        range ENV_GPIO_RANGE_MIN ENV_GPIO_OUT_RANGE_MAX
        default 32
        help
            GPIO number (IOxx) connected to buzzer.

    config BOARD_LED_R_GPIO
        int "Red LED GPIO number"
        range ENV_GPIO_RANGE_MIN ENV_GPIO_OUT_RANGE_MAX
        default 4
        help
            GPIO number (IOxx) connected to red LED.

    config BOARD_LED_G_GPIO
        int "Green LED GPIO number"
        range ENV_GPIO_RANGE_MIN ENV_GPIO_OUT_RANGE_MAX
        default 17
        help
            GPIO number (IOxx) connected to green LED.

    config BOARD_LED_B_GPIO
        int "Blue LED GPIO number"
        range ENV_GPIO_RANGE_MIN ENV_GPIO_OUT_RANGE_MAX
        default 23
        help
            GPIO number (IOxx) connected to blue LED.

    config BOARD_RELAY_GPIO
        int "Relay GPIO number"
        range ENV_GPIO_RANGE_MIN ENV_GPIO_OUT_RANGE_MAX
        default 2
        help
            GPIO number (IOxx) connected to relay.

    config BOARD_LED_IR_GPIO
        int "IR LED GPIO number"
        range ENV_GPIO_RANGE_MIN ENV_GPIO_OUT_RANGE_MAX
        default 33
        help
            GPIO number (IOxx) connected to IR LED.

    config BOARD_IR_FREQ
        int "IR LED blink frequency"
        range 1 100
        default 2
        help
            Frequency [Hz] of IR led blink.

    config BOARD_IR_DUTY
        int "IR LED blink duty"
        range 0 100
        default 12
        help
            Duty [%] of IR led blink.

    config BOARD_WIEGAND_D0_GPIO
        int "Wiegand D0 GPIO number"
        range ENV_GPIO_RANGE_MIN ENV_GPIO_OUT_RANGE_MAX
        default 26
        help
            GPIO number (IOxx) connected to Wiegand D0.

    config BOARD_WIEGAND_D1_GPIO
        int "Wiegand D1 GPIO number"
        range ENV_GPIO_RANGE_MIN ENV_GPIO_OUT_RANGE_MAX
        default 27
        help
            GPIO number (IOxx) connected to Wiegand D1.

    config BOARD_WIEGAND_PULSE
        int "Wiegnad pulse time"
        range 2 10
        default 5
        help
            Time [10us] of active wiegand state.

    config BOARD_WIEGAND_PERIOD
        int "Wiegnad period"
        range 20 2000
        default 100
        help
            Period [10us] of wiegand pulses.

    config BOARD_READER_EN_GPIO
        int "Reader power control GPIO number"
        range ENV_GPIO_RANGE_MIN ENV_GPIO_OUT_RANGE_MAX
        default 25
        help
            GPIO number (IOxx) connected to GM65 regulator.

    config BOARD_READER_TRG_GPIO
        int "Reader trigger GPIO number (unused)"
        range ENV_GPIO_RANGE_MIN ENV_GPIO_OUT_RANGE_MAX
        default 12
        help
            GPIO number (IOxx) connected to GM65 trigger.

    config BOARD_READER_TXD_GPIO
        int "Reader TXD GPIO number"
        range ENV_GPIO_RANGE_MIN ENV_GPIO_OUT_RANGE_MAX
        default 13
        help
            GPIO number (IOxx) connected to GM65 serial input.

    config BOARD_READER_RXD_GPIO
        int "Reader RXD GPIO number"
        range ENV_GPIO_RANGE_MIN ENV_GPIO_OUT_RANGE_MAX
        default 14
        help
            GPIO number (IOxx) connected to GM65 serial ouput.

    config BOARD_READER_ON_DELAY
        int "Reader delay after enable [ms]"
        default 10000
        help
            Delay after power on before communication [ms].

    config BOARD_READER_OFF_DELAY
        int "Reader delay after disable [ms]"
        default 500
        help
            Delay after power off [ms].

    config BOARD_READER_TIMEOUT
        int "Reader communication timeout [ms]"
        default 400
        help
            maximum time between command TX and response RX [ms].

    config BOARD_RTC_INT_GPIO
        int "RTC INT GPIO number (unused)"
        range ENV_GPIO_RANGE_MIN ENV_GPIO_OUT_RANGE_MAX
        default 22
        help
            GPIO number (IOxx) connected to RTC INT.

    config BOARD_VM_ADC_CH
        int "VM ADC channel number number"
        range 0 7
        default 6
        help
            ADC channel number c(ADC1_CHxx) connected to voltage divider.

    config BOARD_BUTTON_GPIO
        int "Button GPIO number"
        range ENV_GPIO_RANGE_MIN ENV_GPIO_IN_RANGE_MAX
        default 15
        help
            GPIO number (IOxx) connected to button.

    config BOARD_BUTTON_DEBOUNCE
        int "Button debounce time [ms]"
        range 10 1000
        default 30
        help
            Button state will be sampled again after this time.

    config BOARD_SERVO1_GPIO
        int "Servo GPIO number"
        range ENV_GPIO_RANGE_MIN ENV_GPIO_OUT_RANGE_MAX
        default 18
        help
            GPIO number (IOxx) connected to servo PWM line.

    config BOARD_SERVO2_GPIO
        int "Servo GPIO number"
        range ENV_GPIO_RANGE_MIN ENV_GPIO_OUT_RANGE_MAX
        default 19
        help
            GPIO number (IOxx) connected to servo PWM line.

    config BOARD_SERVO3_GPIO
        int "Servo GPIO number"
        range ENV_GPIO_RANGE_MIN ENV_GPIO_OUT_RANGE_MAX
        default 21
        help
            GPIO number (IOxx) connected to servo PWM line.

    config BOARD_SERVO_MAX_DEGREE
        int "Servo max. degree"
        range 1 180
        default 90
        help
            Servo maximum movement range [deg].

    config BOARD_SERVO_MIN_PULSEWIDTH_US
        int "Servo min. pulse width [us]"
        range 1 20000
        default 500
        help
            Servo PWM signal min. pulse width [us].

    config BOARD_SERVO_MAX_PULSEWIDTH_US
        int "Servo max. pulse width [us]"
        range 1 20000
        default 2500
        help
            Servo PWM signal max. pulse width [us].

    config BOARD_SERVO_INIT_ANGLE
        int "Servo init angle [deg]"
        range -90 90
        default 20
        help
            Servo initial angle [deg].

endmenu
```

## main/Kconfig.projbuild
```kconfig
menu "IoT Lock Configuration"

    config MAX_CODE_LEN
        int "Maximum supported length of QR code"
        range 26 4296
        default 4296
        help
            Maxumum number of alphanumeric characters in one code.

    config UI_TQ
        int "User interface time quantum [ms]"
        range 10 1000
        default 80
        help
            Define the resolution of LED and beep control.

    config UI_DEF_BRG
        int "Default LED bightness Q8"
        range 0 256
        default 128
        help
            Default global LED brightness level.

    config UI_OPEN_TIME
        int "Lock release time [ms]"
        range 100 10000
        default 4000
        help
            Solenoid will be active during this time.

    config UI_OPEN_DUTY
        int "Lock maximum duty [%]"
        range 10 100
        default 25
        help
            Solenoid will be active at most this % of period.

    config UI_OPEN_PERIOD
        int "Lock duty counting period [s]"
        range 10 6000
        default 60
        help
            Solenoid duty will be counted within this time.

    config CLOUD_RETRY_TIME
        int "Time to wait after a failed upload attempt [s]"
        range 1 3600
        default 30
        help
            Uploading reports will be halted for this time after failure.

endmenu
```

## sdkconfig.defaults
```kconfig
CONFIG_ESPTOOLPY_FLASHSIZE_4MB=y
CONFIG_ESPTOOLPY_FLASHSIZE="4MB"
CONFIG_PARTITION_TABLE_CUSTOM=y
CONFIG_PARTITION_TABLE_FILENAME="partitions.csv"
CONFIG_ESP32_BROWNOUT_DET_LVL_SEL_7=y
CONFIG_ESP32_BROWNOUT_DET_LVL=7
CONFIG_FREERTOS_USE_TRACE_FACILITY=y
CONFIG_FREERTOS_USE_STATS_FORMATTING_FUNCTIONS=y
CONFIG_LWIP_NETBUF_RECVINFO=y
CONFIG_LWIP_SNTP_MAX_SERVERS=4
CONFIG_LWIP_DHCP_GET_NTP_SRV=y
CONFIG_LWIP_DHCP_MAX_NTP_SERVERS=2
CONFIG_MBEDTLS_PSK_MODES=y
CONFIG_MBEDTLS_KEY_EXCHANGE_PSK=y
CONFIG_MBEDTLS_KEY_EXCHANGE_DHE_PSK=y
CONFIG_MBEDTLS_KEY_EXCHANGE_ECDHE_PSK=y
CONFIG_MBEDTLS_KEY_EXCHANGE_RSA_PSK=y
CONFIG_MBEDTLS_SSL_PROTO_DTLS=y
CONFIG_BROWNOUT_DET_LVL_SEL_7=y
CONFIG_BROWNOUT_DET_LVL=7
```
